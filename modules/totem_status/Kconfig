## modules/totem_status/Kconfig
```kconfig
config TOTEM_STATUS
    bool "Report Win/Mac mode and split battery levels to the host over raw HID"
    depends on RAW_HID
    depends on ZMK_SPLIT_ROLE_CENTRAL

if TOTEM_STATUS

config TOTEM_STATUS_WIN_LAYER
    int "Layer index that represents Windows mode"
    default 1

config TOTEM_STATUS_WIN_FALLBACK_MS
    int "Switch to Windows mode when the macOS app stays silent this long after boot (0 = off)"
    default 0
    help
      The dongle has no battery, so it boots every time it is plugged in. It starts in
      macOS mode; the macOS app talks to it within a second or so. If no command arrives
      from the host within this time, it's a machine without the app (Windows) and the
      Windows layer is activated. Once per boot only.

endif

config TOTEM_BATTERY_LIPO
    bool "Battery state of charge from a LiPo discharge curve"
    default y
    depends on DT_HAS_TOTEM_BATTERY_LIPO_ENABLED
    depends on SENSOR

config TOTEM_BATTERY_VOLTAGE_SERVICE
    bool "Expose the battery voltage to the central over GATT (for split halves)"
    depends on BT_PERIPHERAL
    depends on ZMK_BATTERY_REPORTING
    depends on !ZMK_SPLIT_ROLE_CENTRAL

config TOTEM_BATTERY_SAMPLER
    bool "Sample the battery in a burst after boot / USB power changes and while idle"
    depends on BT_BAS
    depends on ZMK_BATTERY_REPORTING
    depends on !ZMK_SPLIT_ROLE_CENTRAL

config TOTEM_BATTERY_SAMPLER_INTERVAL
    int "Seconds between battery samples outside of a burst"
    default 30
    depends on TOTEM_BATTERY_SAMPLER
```

## modules/totem_status/dts/bindings/totem,battery-lipo.yaml
```yaml
description: |
  Battery state of charge from a LiPo discharge curve instead of ZMK's linear
  3.45-4.2 V approximation. Wraps another battery sensor that measures voltage
  (e.g. zmk,battery-voltage-divider) and is meant to be the zmk,battery chosen node.

compatible: "totem,battery-lipo"

properties:
  battery:
    type: phandle
    required: true
    description: Battery sensor providing SENSOR_CHAN_GAUGE_VOLTAGE.
```

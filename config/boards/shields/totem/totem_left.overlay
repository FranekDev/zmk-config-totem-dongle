/*
 * Copyright (c) 2022 The ZMK Contributors
 *
 * SPDX-License-Identifier: MIT
 */

#include "totem-matrix.dtsi"

&kscan0 {
    col-gpios
        = <&xiao_d 4 GPIO_ACTIVE_HIGH>
        , <&xiao_d 5 GPIO_ACTIVE_HIGH>
        , <&xiao_d 10 GPIO_ACTIVE_HIGH>
        , <&xiao_d 9 GPIO_ACTIVE_HIGH>
        , <&xiao_d 8 GPIO_ACTIVE_HIGH>
        ;
};

/* Battery %: LiPo discharge curve on top of the XIAO's voltage divider (modules/totem_status). */
/ {
    chosen {
        zmk,battery = &lipo_batt;
    };

    lipo_batt: lipo_batt {
        compatible = "totem,battery-lipo";
        battery = <&vbatt>;
    };
};
